## meta-isar-ti/conf/machine/am64xx-evm.conf
```bitbake
DISTRO_ARCH = "arm64"

IMAGE_FSTYPES = "targz-img wic-img"
# wks file with partition layout
WKS_FILE ?= "sdimage-2part"

# If recipe name is linux-rt-staging
KERNEL_NAME ?= "rt-staging"

# Filenames to be copy into deploy dir
KERNEL_IMAGE = "Image"
DTB_FILES = "k3-am642-sk.dtb"

U_BOOT_BIN = "u-boot-img.bin"
U_BOOT_CONFIG = "am64x_evm_a53_defconfig"

# Dependency which make package to be build before image generation
IMAGER_BUILD_DEPS += "u-boot-ti-staging"
IMAGER_BUILD_DEPS += "ti-sci-fw"
IMAGER_BUILD_DEPS += "ti-prebuild-bins"

# Install packages into buildchroot, but not in target rootfs
IMAGER_INSTALL += "u-boot-am64xx-evm"
IMAGER_INSTALL += "ti-sci-fw"
IMAGER_INSTALL += "ti-prebuild-bins"

# Files to be copied to the 1st partition (see wks layout)
IMAGE_BOOT_FILES = "${BUILDCHROOT_DIR}/usr/lib/ti-prebuild/uEnv.txt;uEnv.txt \
                    ${BUILDCHROOT_DIR}/usr/lib/ti-sci-fw/tiboot3.bin;tiboot3.bin \
                    ${BUILDCHROOT_DIR}/usr/lib/u-boot/am64xx-evm/tispl.bin;tispl.bin \
                    ${BUILDCHROOT_DIR}/usr/lib/u-boot/am64xx-evm/u-boot.img;u-boot.img"

# Custom packages
# Packages to install from Debian repo
IMAGE_PREINSTALL += "docker-ce docker-ce-cli containerd.io docker-compose"
# Packages were built inside Isar
IMAGE_INSTALL += "codemeter-lite"
```
